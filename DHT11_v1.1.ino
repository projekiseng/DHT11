#include <Adafruit_GFX.h>
#include <Adafruit_SSD1306.h>
#include <DHT.h>

// Pin dan tipe sensor DHT
#define DHTPIN 14
#define DHTTYPE DHT11

// Definisi layar OLED
#define SCREEN_WIDTH 128
#define SCREEN_HEIGHT 64
#define SCREEN_I2C_ADDRESS 0x3C
#define OLED_RESET_PIN -1

// Inisialisasi objek DHT dan OLED
DHT dht(DHTPIN, DHTTYPE);
Adafruit_SSD1306 screen(SCREEN_WIDTH, SCREEN_HEIGHT, &Wire, OLED_RESET_PIN);

// 'temperature', 32x32px
const unsigned char temp_icon[] PROGMEM = {
  0x00, 0x00, 0x00, 0x00, 0x00, 0x0f, 0x00, 0x00, 0x00, 0x1f, 0x80, 0x00, 0x00, 0x18, 0xc0, 0x00, 
	0x00, 0x30, 0xcf, 0x80, 0x00, 0x30, 0xcf, 0x80, 0x00, 0x30, 0xc0, 0x00, 0x00, 0x30, 0xc0, 0x00, 
	0x00, 0x30, 0xcf, 0x80, 0x00, 0x30, 0xc0, 0x00, 0x00, 0x30, 0xc0, 0x00, 0x00, 0x30, 0xcf, 0x80, 
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	0x00, 0x60, 0x70, 0x00, 0x00, 0x3f, 0xe0, 0x00, 0x00, 0x1f, 0x80, 0x00, 0x00, 0x00, 0x00, 0x00
};
// 'humidity', 32x32px
const unsigned char hum_icon[] PROGMEM = {
	0x00, 0x00, 0x00, 0x00, 0x00, 0x00, 0x00, 0x00, 0x00, 0x00, 0x00, 0x00, 0x00, 0x00, 0x00, 0x00, 
	0x00, 0x00, 0x00, 0x00, 0x00, 0x00, 0x06, 0x00, 0x00, 0x00, 0x07, 0x00, 0x00, 0x00, 0x0f, 0x00, 
	0x00, 0x00, 0x0f, 0x80, 0x1c, 0xf3, 0x99, 0x98, 0x0f, 0xff, 0xd9, 0xb0, 0x07, 0x9e, 0x0f, 0x80, 
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	0x00, 0xf0, 0x00, 0x00, 0x00, 0x00, 0x00, 0x00, 0x00, 0x00, 0x00, 0x00, 0x00, 0x00, 0x00, 0x00
};

void setup() {
  // Inisialisasi DHT sensor
  dht.begin();

  // Inisialisasi OLED
  if (!screen.begin(SSD1306_SWITCHCAPVCC, SCREEN_I2C_ADDRESS)) {
    Serial.println("SSD1306 allocation failed");
    for (;;);
  }
  // Bersihkan layar sebelum menampilkan konten baru
  screen.clearDisplay();
}

void loop() {
  delay(1000);
  // Baca data dari sensor
  float t = dht.readTemperature();
  float h = dht.readHumidity();

  // Menampilkan label suhu
  screen.clearDisplay();
  screen.setTextSize(1);
  screen.setTextColor(WHITE);
  screen.setCursor(0, 0);
  screen.print("Temperature:");

  // Menampilkan label kelembapan
  screen.setCursor(0, 35);
  screen.print("Humidity:"); 

  // Validasi pembaca sensor
  if (isnan(t) || isnan(h)) {
    screen.clearDisplay();
    screen.setTextSize(1);
    screen.setCursor(30, 25);
    screen.print("Sensor Error!");
    screen.display();
    return;
  }

  // Menampilkan derajat suhu
  screen.setCursor(0, 12);
  screen.setTextSize(2);
  screen.print(t);
  //screen.print((char)247);
  screen.drawCircle(66, 12, 3, WHITE);
  screen.print(" C");

  // Menampilkan persentase kelembapan
  screen.setCursor(0, 47);
  screen.print(h);
  screen.drawCircle(66, 12, 3, WHITE);
  screen.print(" %");

  screen.drawBitmap(96,0, temp_icon, 32, 32, WHITE);
  screen.drawBitmap(96,32, hum_icon, 32, 32, WHITE);
  screen.display();
}